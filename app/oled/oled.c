#include "oled.h"

/****Discription**********************************************/

/*
	0.oled驱动程序
	1.需先调用oled.Init()函数再使用本驱动
	2.oled.Printf(int, int, char *)函数可以在屏幕上打印字符串
	3.oled.PrintXXXXValue(int, int, data)函数可以在屏幕上打印相应的数值
		具体XXXX的写法参照h文件
	4.字库可以往后面加

	@Time	2018-04-24
	@Author	郭帆
	@Usefor	oled驱动
*/

/****Variables************************************************/

const unsigned char F6x8[][6] =
{
	{ 0x00, 0x00, 0x00, 0x00, 0x00, 0x00 },   // sp
	{ 0x00, 0x00, 0x00, 0x2f, 0x00, 0x00 },   // !
	{ 0x00, 0x00, 0x07, 0x00, 0x07, 0x00 },   // "
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	{ 0x08, 0x08, 0x49, 0x2A, 0x14, 0x08 }    // cursor
};

/****Function list********************************************/

void OLED_WriteData(unsigned char data);
void OLED_WriteCmd(unsigned char cmd);
void OLED_SetPosition(unsigned char x, unsigned char y);
void OLED_Fill(unsigned char bmp_data);
void OLED_DelayMs(unsigned int ms);

void SetStartColumn(unsigned char column);
void SetAddressingMode(unsigned char mode);
void SetColumnAddress(unsigned char begin, unsigned char end);
void SetPageAddress(unsigned char begin, unsigned char end);
void SetStartLine(unsigned char line);
void SetContrastControl(unsigned char contrast);
void SetChargePump(unsigned char cmd);
void SetSegmentRemap(unsigned char cmd);
void SetEntireDisplay(unsigned char cmd);
void SetInverseDisplay(unsigned char cmd);
void SetMultiplexRatio(unsigned char cmd);
void SetDisplay_On_Off(unsigned char cmd);
void SetStartPage(unsigned char address);
void SetCommonRemap(unsigned char dir);
void SetDisplayOffset(unsigned char cmd);
void SetDisplayClock(unsigned char cmd);
void SetPrechargePeriod(unsigned char cmd);
void SetCommonConfig(unsigned char cmd);
void SetVCOMH(unsigned char cmd);
void SetNOP(void);
void OLED_Init(void);
void OLED_GPIO_Config(void);

void OLED_Put6x8Char(unsigned char x, unsigned char y, unsigned char ch);
void OLED_Put6x8Str(unsigned char x, unsigned char y, unsigned char ch[]);
void OLED_PrintCharValue(unsigned char x, unsigned char y, unsigned char data);
void OLED_PrintIntValue(unsigned char x, unsigned char y, int data);
void OLED_PrintUintValue(unsigned char x, unsigned char y, unsigned int data);
void OLED_PrintFloatValue(unsigned char x, unsigned char y, float data);
void OLED_DisplayImgCalc(void);
void OLED_DisplayImg(void);
void OLED_Put16x16CH(unsigned char x, unsigned char y, unsigned char num);
void OLED_DispACat(unsigned char x, unsigned char y);
void OLED_DispAImg(void);
void OLED_DispMyScene(void);

/****Objects**************************************************/

OLED_CLASS oled =
{
	&OLED_Init,
	&OLED_Put6x8Char,
	&OLED_Put6x8Str,
	&OLED_PrintCharValue,
	&OLED_PrintIntValue,
	&OLED_PrintUintValue,
	&OLED_PrintFloatValue,
	&OLED_DisplayImgCalc,
	&OLED_DisplayImg,
	&OLED_Put16x16CH,
	&OLED_DispACat,
	&OLED_DispAImg,
	&OLED_DispMyScene
};

/****Functions************************************************/

void OLED_WriteData(unsigned char data)
{
	unsigned char i = 8;

	OLED_DC(1);
	OLED_SCLK(0);

	while(i--)
	{
		if(data & 0x80)
			OLED_SDA(1);
		else
			OLED_SDA(0);

		OLED_SCLK(1);
		asm("nop");
		OLED_SCLK(0);

		data <<= 1;
	}
}

void OLED_WriteCmd(unsigned char cmd)
{
	unsigned char i = 8;

	OLED_DC(0);
	OLED_SCLK(0);

	while(i--)
	{
		if(cmd & 0x80)
			OLED_SDA(1);
		else
			OLED_SDA(0);

		OLED_SCLK(1);
		asm("nop");
		OLED_SCLK(0);

		cmd <<= 1;
	}
}

void OLED_SetPosition(unsigned char x, unsigned char y)
{
	OLED_WriteCmd(0xB0 + y);
	OLED_WriteCmd(((x & 0xF0) >> 4) | 0x10);
	OLED_WriteCmd((x & 0x0F) | 0x00);
}

void OLED_Fill(unsigned char bmp_data)
{
	unsigned char x, y;

	for(y = 0 ; y < 8 ; y++)
	{
		OLED_WriteCmd(0xB0 + y);	// 0xb0 + 0~7 means page 0~7
		OLED_WriteCmd(0x00);	// 0x00 + 0~16 means 128 pixs / 16
		OLED_WriteCmd(0x10);	// 0x10 + 0~16 means 128 pixs / 16 groups

		for(x = 0 ; x < 128 ; x++)
			OLED_WriteData(bmp_data);
	}
}

void OLED_DelayMs(unsigned int ms)
{
	uint16 i;
	while(ms--)
	{
		i = 6675;
		while(i--);
	}
}

void SetStartColumn(unsigned char column)
{
	OLED_WriteCmd(0x00 + column % 16);	// Set Lower Column Start Address for Page Addressing Mode
										// Default => 0x00
	OLED_WriteCmd(0x10 + column / 16);	// Set Higher Column Start Address for Page Addressing Mode
										// Default => 0x10
}

void SetAddressingMode(unsigned char mode)
{
	OLED_WriteCmd(0x20);	// Set Memory Addressing Mode
	OLED_WriteCmd(mode);	// Default => 0x02
							// 0x00 => Horizontal Addressing Mode
							// 0x01 => Vertical Addressing Mode
							// 0x02 => Page Addressing Mode
}

void SetColumnAddress(unsigned char begin, unsigned char end)
{
	OLED_WriteCmd(0x21);	// Set Column Address
	OLED_WriteCmd(begin);	// Default => 0x00 (Column Begin Address)
	OLED_WriteCmd(end);		// Default => 0x7F (Column End Address)
}

void SetPageAddress(unsigned char begin, unsigned char end)
{
	OLED_WriteCmd(0x22);	// Set Page Address
	OLED_WriteCmd(begin);	// Default => 0x00 (Page Begin Address)
	OLED_WriteCmd(end);		// Default => 0x7F (Page End Address)
}

void SetStartLine(unsigned char line)
{
	OLED_WriteCmd(0x40 | line);	// Set Display Start Line
								// Default => 0x40 (0x00)
}

void SetContrastControl(unsigned char contrast)
{
	OLED_WriteCmd(0x81);		// Set Contrast Control
	OLED_WriteCmd(contrast);	// Default => 0x7F
}

void SetChargePump(unsigned char cmd)
{
	OLED_WriteCmd(0x8D);		// Set Charge Pump
	OLED_WriteCmd(0x10 | cmd);	// Default => 0x10
								// 0x10 (0x00) => Disable Charge Pump
								// 0x14 (0x04) => Enable Charge Pump
}

void SetSegmentRemap(unsigned char cmd)
{
	OLED_WriteCmd(0xA0 | cmd);	// Set Segment Re-Map
								// Default => 0xA0
								// 0xA0 (0x00) => Column Address 0 Mapped to SEG0
								// 0xA1 (0x01) => Column Address 0 Mapped to SEG127
}

void SetEntireDisplay(unsigned char cmd)
{
	OLED_WriteCmd(0xA4 | cmd);	// Set Entire Display On / Off
								// Default => 0xA4
								// 0xA4 (0x00) => Normal Display
								// 0xA5 (0x01) => Entire Display On
}

void SetInverseDisplay(unsigned char cmd)
{
	OLED_WriteCmd(0xA6 | cmd);	// Set Inverse Display On/Off
								// Default => 0xA6
								// 0xA6 (0x00) => Normal Display
								// 0xA7 (0x01) => Inverse Display On
}

void SetMultiplexRatio(unsigned char cmd)
{
	OLED_WriteCmd(0xA8);	// Set Multiplex Ratio
	OLED_WriteCmd(cmd);		// Default => 0x3F (1/64 Duty)
}

void SetDisplay_On_Off(unsigned char cmd)
{
	OLED_WriteCmd(0xAE | cmd);	// Set Display On/Off
								// Default => 0xAE
								// 0xAE (0x00) => Display Off
								// 0xAF (0x01) => Display On
}

void SetStartPage(unsigned char address)
{
	OLED_WriteCmd(0xB0 | address);	// Set Page Start Address for Page Addressing Mode
									// Default => 0xB0 (0x00)
}

void SetCommonRemap(unsigned char dir)
{
	OLED_WriteCmd(0xC0 | dir);	// Set COM Output Scan Direction
								// Default => 0xC0
								// 0xC0 (0x00) => Scan from COM0 to 63
								// 0xC8 (0x08) => Scan from COM63 to 0
}

void SetDisplayOffset(unsigned char cmd)
{
	OLED_WriteCmd(0xD3);	// Set Display Offset
	OLED_WriteCmd(cmd);		// Default => 0x00
}

void SetDisplayClock(unsigned char cmd)
{
	OLED_WriteCmd(0xD5);	// Set Display Clock Divide Ratio / Oscillator Frequency
	OLED_WriteCmd(cmd);		// Default => 0x80
							// D[3:0] => Display Clock Divider
							// D[7:4] => Oscillator Frequency
}

void SetPrechargePeriod(unsigned char cmd)
{
	OLED_WriteCmd(0xD9);	// Set Pre-Charge Period
	OLED_WriteCmd(cmd);		// Default => 0x22 (2 Display Clocks [Phase 2] / 2 Display Clocks [Phase 1])
							// D[3:0] => Phase 1 Period in 1~15 Display Clocks
							// D[7:4] => Phase 2 Period in 1~15 Display Clocks
}

void SetCommonConfig(unsigned char cmd)
{
	OLED_WriteCmd(0xDA);		// Set COM Pins Hardware Configuration
	OLED_WriteCmd(0x02 | cmd);	// Default => 0x12 (0x10)
								// Alternative COM Pin Configuration
								// Disable COM Left/Right Re-Map
}

void SetVCOMH(unsigned char cmd)
{
	OLED_WriteCmd(0xDB);	// Set VCOMH Deselect Level
	OLED_WriteCmd(cmd);		// Default => 0x20 (0.77*VCC)
}

void SetNOP(void)
{
	OLED_WriteCmd(0xE3);	// Command for No Operation
}

void OLED_Init(void)
{
	OLED_GPIO_Config();

	OLED_DC(0);
	OLED_SDA(0);
	OLED_SCLK(0);
	OLED_RST(0);
	OLED_DelayMs(50);
	OLED_SCLK(1);
	OLED_RST(0);
	OLED_DelayMs(50);
	OLED_RST(1);

	SetDisplay_On_Off(0x00);	// Display Off (0x00/0x01)
	SetDisplayClock(0x80);		// Set Clock as 100 Frames/Sec
	SetMultiplexRatio(0x3F);	// 1/64 Duty (0x0F~0x3F)
	SetDisplayOffset(0x00);		// Shift Mapping RAM Counter (0x00~0x3F)
	SetStartLine(0x00);			// Set Mapping RAM Display Start Line (0x00~0x3F)
	SetChargePump(0x04);		// Enable Embedded DC/DC Converter (0x00/0x04)
	SetAddressingMode(0x02);	// Set Page Addressing Mode (0x00/0x01/0x02)
	SetSegmentRemap(0x01);		// Set SEG/Column Mapping     0x00左右反置 0x01正常
	SetCommonRemap(0x08);		// Set COM/Row Scan Direction 0x00上下反置 0x08正常
	SetCommonConfig(0x10);		// Set Sequential Configuration (0x00/0x10)
	SetContrastControl(0xCF);	// Set SEG Output Current
	SetPrechargePeriod(0xF1);	// Set Pre-Charge as 15 Clocks & Discharge as 1 Clock
	SetVCOMH(0x40);				// Set VCOM Deselect Level
	SetEntireDisplay(0x00);		// Disable Entire Display On (0x00/0x01)
	SetInverseDisplay(0x00);	// Disable Inverse Display On (0x00/0x01)
	SetDisplay_On_Off(0x01);	// Display On (0x00/0x01)
	OLED_Fill(0x00);
	OLED_SetPosition(0,0);
}

void OLED_GPIO_Config(void)
{
	static GPIO_InitTypeDef GPIO_InitStructure;

	GPIO_InitStructure.GPIO_PTx = OLED_GPIO_PTx;
	GPIO_InitStructure.GPIO_Pins =  OLED_GPIO_SCLK | OLED_GPIO_SDA | OLED_GPIO_RST | OLED_GPIO_DC;
	GPIO_InitStructure.GPIO_Dir = DIR_OUTPUT;
	GPIO_InitStructure.GPIO_Output = OUTPUT_H;

	LPLD_GPIO_Init(GPIO_InitStructure);
}

void OLED_Put6x8Char(unsigned char x, unsigned char y, unsigned char ch)
{
	unsigned char c = 0, i = 0;

	c = ch - 32;

	if(x > 122)
	{
		x = 0;
		y++;
	}
	OLED_SetPosition(x, y);

	for(i = 0 ; i < 6 ; i++)
		OLED_WriteData(F6x8[c][i]);
}

void OLED_Put6x8Str(unsigned char x, unsigned char y, unsigned char ch[])
{
	unsigned char c = 0, i = 0, j = 0;

	while(ch[j] != '\0')
	{
		c = ch[j] - 32;

		if(x > 126)
		{
			x = 0;
			y++;
		}
		OLED_SetPosition(x, y);

		for(i = 0 ; i < 6 ; i++)
			OLED_WriteData(F6x8[c][i]);
		x += 6;
		j++;
	}
}

void OLED_PrintCharValue(unsigned char x, unsigned char y, unsigned char data)
{
	OLED_Put6x8Char(x, y, (data / 100) + 48);
	OLED_Put6x8Char(x + 6, y, ((data % 100) / 10) + 48);
	OLED_Put6x8Char(x + 12, y, (data % 10) + 48);
}

void OLED_PrintIntValue(unsigned char x, unsigned char y, int data)
{
	if(data < 0)
	{
			OLED_Put6x8Char(x, y, '-');
			data = -data;
	}
	else
			OLED_Put6x8Char(x, y, '+');

	OLED_Put6x8Char(x + 6, y, (data / 1000) + 48);
	OLED_Put6x8Char(x + 12, y, ((data % 1000) / 100) + 48);
	OLED_Put6x8Char(x + 18, y, ((data % 100) / 10) + 48);
	OLED_Put6x8Char(x + 24, y, (data % 10) + 48);
}

void OLED_PrintUintValue(unsigned char x, unsigned char y, unsigned int data)
{
	OLED_Put6x8Char(x + 0, y, (data / 1000) + 48);
	OLED_Put6x8Char(x + 6, y, ((data % 1000) / 100) + 48);
	OLED_Put6x8Char(x + 12, y, ((data % 100) / 10) + 48);
	OLED_Put6x8Char(x + 18, y, (data % 10) + 48);
}

void OLED_PrintFloatValue(unsigned char x, unsigned char y, float data)
{
	int temp;

	temp = (int)data;
	OLED_Put6x8Char(x + 0, y, ((temp % 1000) / 100) + 48);
	OLED_Put6x8Char(x + 6, y, ((temp % 100) / 10) + 48);
	OLED_Put6x8Char(x + 12, y, (temp % 10) + 48);

	OLED_Put6x8Char(x + 18, y, '.');

	data = data * 100000 + 1;
	temp = (int)data;
	temp %= 100000;
	OLED_Put6x8Char(x + 24, y, (temp / 10000) + 48);
	OLED_Put6x8Char(x + 30, y, ((temp % 10000) / 1000) + 48);
	OLED_Put6x8Char(x + 36, y, ((temp % 1000) / 100) + 48);
}

static uint8 getBufPix(uint8 x, uint8 y)
{
	extern uint8 ubyRange;

	if (ubyRange)
	{
		return !(camera.buf1[x][y / 8] & (1 << (7 - (y % 8))));
	}
	else
	{
		return !(camera.buf2[x][y / 8] & (1 << (7 - (y % 8))));
	}
}

void OLED_DisplayImgCalc(void)
{
	uint8 data;
	uint8 i, j;
	int cnt;

	for (i = 0; i < 8; i++)
	{
		OLED_WriteCmd(0xb0 + i);
		OLED_WriteCmd(0x01);
		OLED_WriteCmd(0x10);
		for (j = 0; j < 128; j++)
		{
			data = 0;

			for (cnt = 7; cnt >= 0; cnt--)
			{
				data <<= 1;
				data |= (camera.img[((i << 3) + cnt) << 1][j + (j >> 2)] && 1);
			}

			if (i == 7)
				data &= 0x0F;

			OLED_WriteData(data);
		}
	}
}

void OLED_DisplayImg(void)
{
	uint8 i, j;
	uint8 data;
	int cnt;

	for (i = 0; i < 8; i++)
	{
		OLED_WriteCmd(0xb0 + i);
		OLED_WriteCmd(0x01);
		OLED_WriteCmd(0x10);
		for (j = 0; j < 128; j++)
		{
			data = 0;

			for (cnt = 7; cnt >= 0; cnt--)
			{
				data <<= 1;
				data |= (getBufPix(((i << 3) + cnt) << 1, j + (j >> 2)) && 1);
			}

			if (i == 7)
				data &= 0x0F;

			OLED_WriteData(data);
		}
	}
}

const unsigned char CH16x16[][32] =
{
	{0xFC,0x04,0xFC,0x00,0x12,0x64,0x10,0x08,0xF7,0x14,0x54,0x94,0x14,0xF4,0x04,0x00,
	0x0F,0x04,0x0F,0x00,0x04,0x7E,0x01,0x1D,0x13,0x11,0x55,0x99,0x51,0x3F,0x11,0x00}, // 0 hai
	{0x00,0x80,0x60,0xF8,0x07,0x40,0x20,0x18,0x0F,0x08,0xC8,0x08,0x08,0x28,0x18,0x00,
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	0x00,0x0F,0x00,0xFF,0x08,0x8F,0x60,0x1F,0x00,0x01,0x00,0x3F,0x40,0x40,0x78,0x00}, // 18
	{0}
};

void OLED_Put16x16CH(unsigned char x, unsigned char y, unsigned char num)
{
	unsigned char c = 0, i = 0;

	c = num;

	if (x > 114)
	{
		x = 0;
		y++;
	}
	OLED_SetPosition(x, y);

	for (i = 0; i < 16; i++)
		OLED_WriteData(CH16x16[c][i]);

	y++;
	OLED_SetPosition(x, y);

	for (i = 16; i < 32; i++)
		OLED_WriteData(CH16x16[c][i]);
}

const unsigned char OLED_cat[] =
{
	0x00,0x00,0x00,0x00,0xE0,0xF0,0xF0,0xE0,0xE0,0xC0,0x80,0x00,0x00,0x00,0x00,0x00,
	0x00,0x00,0x00,0x00,0x80,0xC0,0xE0,0xE0,0xF0,0xF0,0xE0,0x00,0x00,0x00,0x00,0x00,
	0x00,0x00,0x00,0x00,0xC1,0xFF,0xFF,0xFF,0xFF,0x7F,0x7F,0x7F,0xFE,0xFE,0xFE,0xFE,
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	0x07,0x07,0x07,0x07,0x03,0x03,0x01,0x01,0x00,0x00,0x00,0x00,0x00,0x00,0x00,0x00
};

void OLED_DispACat(unsigned char x, unsigned char y)
{
	unsigned char i = 0, j = 0;

	if (x > 96)
	{
		x = 0;
		y++;
	}

	for (j = 0; j < 4; j++)
	{
		OLED_SetPosition(x, y);
		y++;

		for (i = 0; i < 32; i++)
			OLED_WriteData(OLED_cat[i + j * 32]);
	}
}

const unsigned char OLED_img[] =
{
	0x00,0x00,0x00,0x00,0x00,0x00,0x00,0x00,0x00,0x00,0x00,0x00,0x00,0x00,0x00,0x00,
	0x00,0x00,0x00,0x00,0x00,0x00,0x00,0x00,0x00,0x00,0x00,0x00,0x00,0x00,0x00,0x00,
	0x00,0x00,0x00,0x00,0x00,0x00,0x00,0x00,0x00,0x00,0x00,0x00,0x00,0x00,0x00,0x00,
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	0x00,0x00,0x00,0x00,0x00,0x00,0x00,0x00,0x00,0x00,0x00,0x00,0x00,0x00,0x00,0x00
};

void OLED_DispAImg(void)
{
	int i, j;

	for (i = 0; i < 8; i++)
	{
		OLED_SetPosition(0, i);

		for (j = 0; j < 128; j++)
			OLED_WriteData(OLED_img[j + i * 128]);
	}
}

void OLED_DispMyScene(void)
{
	int i, j;

	for (i = 0; i < 8; i++)
	{
		OLED_SetPosition(0, i);

		for (j = 0; j < 128; j++)
			OLED_WriteData(calc.myScene[j][i]);
	}
}
